## Documentation/devicetree/bindings/hwmon/microchip,lan9691-fan.yaml
```yaml
# SPDX-License-Identifier: (GPL-2.0-only OR BSD-2-Clause)
%YAML 1.2
---
$id: http://devicetree.org/schemas/hwmon/microchip,lan9691-fan.yaml#
$schema: http://devicetree.org/meta-schemas/core.yaml#

title: Microchip LAN969x Fan Controller

maintainers:
  - Robert Marko <robert.marko@sartura.hr>

description: |
  LAN969x fan controller with a PWM output and tachometer input. The fan
  child's pwms property references this node to specify the PWM period and
  polarity.

properties:
  compatible:
    const: microchip,lan9691-fan

  reg:
    maxItems: 1

  clocks:
    items:
      - description: System reference clock

  '#pwm-cells':
    const: 2
    description: |
      Number of cells in a PWM specifier.
      - cell 0: PWM period in nanoseconds
      - cell 1: PWM polarity: 0 or PWM_POLARITY_INVERTED

  fan:
    $ref: fan-common.yaml#
    unevaluatedProperties: false

    properties:
      cooling-levels:
        description:
          PWM duty-cycle values corresponding to thermal cooling states.
        items:
          maximum: 255

      pulses-per-revolution:
        minimum: 1
        maximum: 4
        default: 2

    required:
      - pwms

    dependencies:
      '#cooling-cells':
        - cooling-levels
      cooling-levels:
        - '#cooling-cells'

required:
  - compatible
  - reg
  - clocks
  - '#pwm-cells'

additionalProperties: false

examples:
  - |
    #include <dt-bindings/pwm/pwm.h>

    fanctrl: fan-controller@e2010348 {
        compatible = "microchip,lan9691-fan";
        reg = <0xe2010348 0xc>;
        clocks = <&sys_clk>;
        #pwm-cells = <2>;

        fan {
            pwms = <&fanctrl 40000 PWM_POLARITY_INVERTED>;
            cooling-levels = <0 128 192 255>;
            #cooling-cells = <2>;
        };
    };
```

## Documentation/devicetree/bindings/hwmon/microchip,sparx5-temp.yaml
```yaml
# SPDX-License-Identifier: (GPL-2.0-only OR BSD-2-Clause)
%YAML 1.2
---
$id: http://devicetree.org/schemas/hwmon/microchip,sparx5-temp.yaml#
$schema: http://devicetree.org/meta-schemas/core.yaml#

title: Microchip Sparx5 Hardware Monitor

maintainers:
  - Lars Povlsen <lars.povlsen@microchip.com>

description: |
  Microchip Sparx5 embedded temperature monitor. On LAN969x, the hardware
  monitor also contains a PWM fan controller with a tachometer input.

properties:
  compatible:
    oneOf:
      - const: microchip,sparx5-temp
      - items:
          - enum:
              - microchip,lan9691-hwmon
              - microchip,lan9691-temp
          - const: microchip,sparx5-temp

  reg:
    minItems: 1
    maxItems: 2

  reg-names:
    minItems: 1
    items:
      - const: temp
      - const: fan

  clocks:
    items:
      - description: System reference clock

  '#thermal-sensor-cells':
    const: 0

  '#pwm-cells':
    const: 2
    description: |
      Number of cells in a PWM specifier.
      - cell 0: PWM period in nanoseconds
      - cell 1: PWM polarity: 0 or PWM_POLARITY_INVERTED

  fan:
    $ref: fan-common.yaml#
    unevaluatedProperties: false

    properties:
      cooling-levels:
        description:
          PWM duty-cycle values corresponding to thermal cooling states.
        items:
          maximum: 255

      pulses-per-revolution:
        minimum: 1
        maximum: 4
        default: 2

    required:
      - pwms

    dependencies:
      '#cooling-cells':
        - cooling-levels
      cooling-levels:
        - '#cooling-cells'

required:
  - compatible
  - reg
  - clocks

allOf:
  - if:
      properties:
        compatible:
          contains:
            const: microchip,lan9691-hwmon
    then:
      properties:
        reg:
          minItems: 2
        reg-names:
          minItems: 2
      required:
        - '#pwm-cells'
        - reg-names
    else:
      properties:
        '#pwm-cells': false
        fan: false
        reg:
          maxItems: 1
        reg-names:
          maxItems: 1

additionalProperties: false

examples:
  - |
    tmon0: tmon@610508110 {
        compatible = "microchip,sparx5-temp";
        reg = <0x10508110 0xc>;
        #thermal-sensor-cells = <0>;
        clocks = <&sys_clk>;
    };

  - |
    #include <dt-bindings/pwm/pwm.h>

    hwmon: hwmon@e2020100 {
        compatible = "microchip,lan9691-hwmon", "microchip,sparx5-temp";
        reg = <0xe2020100 0xc>, <0xe2010348 0xc>;
        reg-names = "temp", "fan";
        #pwm-cells = <2>;
        #thermal-sensor-cells = <0>;
        clocks = <&sys_clk>;

        fan {
            pwms = <&hwmon 40000 PWM_POLARITY_INVERTED>;
            cooling-levels = <0 128 192 255>;
            #cooling-cells = <2>;
        };
    };
```

## Documentation/devicetree/bindings/net/maxlinear,gpy2xx.yaml
```yaml
# SPDX-License-Identifier: GPL-2.0-only OR BSD-2-Clause
%YAML 1.2
---
$id: http://devicetree.org/schemas/net/maxlinear,gpy2xx.yaml#
$schema: http://devicetree.org/meta-schemas/core.yaml#

title: MaxLinear GPY2xx PHY

maintainers:
  - Andrew Lunn <andrew@lunn.ch>
  - Michael Walle <michael@walle.cc>

select:
  anyOf:
    - properties:
        compatible:
          contains:
            const: ethernet-phy-idc133.5400
      required:
        - compatible
    - required:
        - maxlinear,use-broken-interrupts

allOf:
  - $ref: ethernet-phy.yaml#
  - if:
      not:
        properties:
          compatible:
            contains:
              const: ethernet-phy-idc133.5400
        required:
          - compatible
    then:
      properties:
        vddp-supply: false

properties:
  vddp-supply:
    description: |
      Optional regulator supplying the VDDP pin. Its voltage configures the
      MDIO, MDC, and MDINT pad voltage and must be either 1.8 V or 3.3 V.

  maxlinear,use-broken-interrupts:
    description: |
      Interrupts are broken on some GPY2xx PHYs in that they keep the
      interrupt line asserted for a random amount of time even after the
      interrupt status register is cleared. Thus it is blocking the
      interrupt line which is usually bad for shared lines. By default,
      interrupts are disabled for this PHY and polling mode is used. If one
      can live with the consequences, this property can be used to enable
      interrupt handling.

      Affected PHYs (as far as known) are GPY215B and GPY215C.
    type: boolean

dependencies:
  maxlinear,use-broken-interrupts: [ interrupts ]

unevaluatedProperties: false

examples:
  - |
    ethernet {
        #address-cells = <1>;
        #size-cells = <0>;

        ethernet-phy@0 {
            reg = <0>;
            interrupts-extended = <&intc 0>;
            maxlinear,use-broken-interrupts;
        };
    };

  - |
    vddp: regulator-vddp {
        compatible = "regulator-fixed";
        regulator-name = "vddp";
        regulator-min-microvolt = <1800000>;
        regulator-max-microvolt = <1800000>;
    };

    ethernet {
        #address-cells = <1>;
        #size-cells = <0>;

        ethernet-phy@0 {
            compatible = "ethernet-phy-idc133.5400",
                         "ethernet-phy-ieee802.3-c45";
            reg = <0>;
            vddp-supply = <&vddp>;

        };
    };

...
```

## Documentation/devicetree/bindings/nvmem/layouts/microchip,otp-layout.yaml
```yaml
# SPDX-License-Identifier: (GPL-2.0 OR BSD-2-Clause)
%YAML 1.2
---
$id: http://devicetree.org/schemas/nvmem/layouts/microchip,otp-layout.yaml#
$schema: http://devicetree.org/meta-schemas/core.yaml#

title: Microchip OTP layout

maintainers:
  - Robert Marko <robert.marko@sartura.hr>

properties:
  compatible:
    const: microchip,otp-layout

  partid:
    type: object
    additionalProperties: false

  feat-ids:
    type: object
    additionalProperties: false

  serial-number:
    type: object
    additionalProperties: false

  password:
    type: object
    additionalProperties: false

  pcb:
    type: object
    additionalProperties: false

  revision:
    type: object
    additionalProperties: false

  base-mac-address:
    type: object
    description:
      Base MAC address for all on-module network interfaces. The first
      argument of the phandle will be treated as an offset.

    properties:
      "#nvmem-cell-cells":
        const: 1

    additionalProperties: false

  mac-address-count:
    type: object
    additionalProperties: false

  fit-config:
    type: object
    additionalProperties: false

  pcb2:
    type: object
    additionalProperties: false

required:
  - compatible

additionalProperties: false
```
